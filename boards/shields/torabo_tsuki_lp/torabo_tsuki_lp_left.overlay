#include "torabo_tsuki_lp.dtsi"
#include <input/processors.dtsi>
#include <dt-bindings/zmk/input_transform.h>

&zip_temp_layer {
    require-prior-idle-ms = <200>;
    excluded-positions = <
        16 //J
        17 //K
        18 //L
        19 //;
    >;
};

&trackball_listener {
    input-processors = <
        &zip_xy_transform (INPUT_TRANSFORM_X_INVERT | INPUT_TRANSFORM_Y_INVERT)
        &zip_temp_layer 5 10000
    >;
    scroller {
        layers = <4>;
        input-processors = <
            &zip_xy_to_scroll_mapper
            &zip_scroll_scaler 1 8
            &zip_scroll_transform INPUT_TRANSFORM_X_INVERT
        >;
    };
};
